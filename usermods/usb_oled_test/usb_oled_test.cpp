#include "wled.h"

// Linked only from the ttgo_t32 environment. WLED_DISABLE_ADALIGHT must stay
// set there, otherwise handleSerial() consumes the USB bytes first.

#ifdef ARDUINO_ARCH_ESP32

#include <Wire.h>

#pragma push_macro("R")
#pragma push_macro("G")
#pragma push_macro("B")
#pragma push_macro("W")
#undef R
#undef G
#undef B
#undef W
#define DEBUGLOG_DEFAULT_LOG_LEVEL_ERROR
#include <MsgPack.h>
#pragma pop_macro("W")
#pragma pop_macro("B")
#pragma pop_macro("G")
#pragma pop_macro("R")

#ifdef WHITE
#undef WHITE
#endif
#ifdef BLACK
#undef BLACK
#endif
#include <Adafruit_GFX.h>
#include <Adafruit_SSD1306.h>

// AI: below section was generated by an AI
// USB frame: 0xA5 0x5A length payload, 115200 baud.
// length is one byte (1..255). payload is one MessagePack object with the
// same keys as POST /json/state. GPIO 4 is the LED data pin of this build.
// The SSD1306 on SDA 21 / SCL 22 shows whether the frame arrived and
// whether MessagePack decompression succeeded. No LED strip is required.

namespace {
constexpr size_t kMaxPacket = 255;
constexpr uint8_t kMagic0 = 0xA5;
constexpr uint8_t kMagic1 = 0x5A;
constexpr uint8_t kOledAddress = 0x3C;
constexpr int8_t kOledSda = 21;
constexpr int8_t kOledScl = 22;
constexpr uint32_t kGapMs = 300;
constexpr uint32_t kUsbBaud = 115200;

enum class FrameResult : uint8_t { Ok, FormatError, SizeError };

Adafruit_SSD1306 oled(128, 64, &Wire, -1);
bool oledReady = false;
uint32_t unpackedCount = 0;

void paintStatus(const char* reception, const char* decompression, uint32_t count) {
  if (!oledReady) return;
  char countLine[16];
  snprintf(countLine, sizeof(countLine), "n:%lu", (unsigned long)count);
  oled.clearDisplay();
  oled.setTextColor(SSD1306_WHITE);
  oled.setTextSize(1);
  oled.setCursor(0, 0);
  oled.print("Recepcion");
  oled.setCursor(96, 0);
  oled.print(countLine);
  oled.setTextSize(2);
  oled.setCursor(0, 12);
  oled.print(reception);
  oled.setTextSize(1);
  oled.setCursor(0, 34);
  oled.print("Descompresion");
  oled.setTextSize(2);
  oled.setCursor(0, 46);
  oled.print(decompression);
  oled.display();
}

void showResult(FrameResult result) {
  const bool arrived = result != FrameResult::SizeError;
  const bool unpacked = result == FrameResult::Ok;
  if (unpacked) unpackedCount++;
  paintStatus(arrived ? "OK" : "Error", unpacked ? "OK" : (arrived ? "Error" : "--"), unpackedCount);
  Serial.print(F("Recepcion "));
  Serial.println(arrived ? F("OK") : F("Error"));
  Serial.print(F("Descompresion "));
  Serial.println(unpacked ? F("OK") : (arrived ? F("Error") : F("--")));
}

FrameResult applyPayload(const uint8_t* data, size_t len) {
  if (len == 0 || len > kMaxPacket) return FrameResult::SizeError;
  if (!requestJSONBufferLock(JSON_LOCK_USB)) return FrameResult::FormatError;

  FrameResult result = FrameResult::FormatError;
  MsgPack::Unpacker unpacker;
  if (unpacker.feed(data, len)) {
#if defined(BOARD_HAS_PSRAM)
    const bool unpacked = !deserializeMsgPack(*pDoc, data, len);
#else
    const bool unpacked = unpacker.deserialize(gDoc);
#endif
    if (unpacked) {
      result = FrameResult::Ok;
      JsonObject root = pDoc->as<JsonObject>();
      if (!root.isNull()) {
        JsonObject nested = root[F("state")].as<JsonObject>();
        const bool bareState = !root[F("on")].isNull() || !root[F("bri")].isNull() || !root[F("seg")].isNull() || !root[F("ps")].isNull();
        if (!nested.isNull() && !bareState) root = nested;
        if (!root.isNull()) deserializeState(root, CALL_MODE_DIRECT_CHANGE);
      }
    }
  }

  releaseJSONBufferLock();
  return result;
}

void pollSerial() {
  static uint8_t payload[kMaxPacket];
  static uint8_t expected = 0;
  static uint8_t filled = 0;
  static uint8_t step = 0;
  static uint32_t lastByteMs = 0;

  if (step != 0 && (uint32_t)(millis() - lastByteMs) > kGapMs) {
    step = 0;
    filled = 0;
    showResult(FrameResult::SizeError);
  }

  while (Serial.available() > 0) {
    const int raw = Serial.read();
    if (raw < 0) return;
    const uint8_t byte = (uint8_t)raw;
    lastByteMs = millis();

    if (step == 0) {
      if (byte == kMagic0) step = 1;
    } else if (step == 1) {
      step = (byte == kMagic1) ? 2 : (byte == kMagic0 ? 1 : 0);
    } else if (step == 2) {
      if (byte == 0 || byte > kMaxPacket) {
        step = 0;
        showResult(FrameResult::SizeError);
      } else {
        expected = byte;
        filled = 0;
        step = 3;
      }
    } else {
      payload[filled++] = byte;
      if (filled == expected) {
        step = 0;
        showResult(applyPayload(payload, expected));
      }
    }
  }
}

void initOled() {
  Wire.begin(kOledSda, kOledScl);
  oledReady = oled.begin(SSD1306_SWITCHCAPVCC, kOledAddress, false, false);
  if (!oledReady) {
    Serial.println(F("OLED no disponible"));
    return;
  }
  paintStatus("--", "--", 0);
}
}  // namespace

class UsbOledTestUsermod : public Usermod {
 public:
  void setup() override {
    Serial.begin(kUsbBaud);
    initOled();
  }

  void loop() override {
    pollSerial();
  }

  uint16_t getId() override { return USERMOD_ID_USB_OLED; }
};

static UsbOledTestUsermod usbOledTestUsermod;
REGISTER_USERMOD(usbOledTestUsermod);
// AI: end

#endif  // ARDUINO_ARCH_ESP32
