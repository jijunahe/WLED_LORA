#include "wled.h"

#ifdef ARDUINO_ARCH_ESP32

#include <SPI.h>
#include <RadioLib.h>
#include <atomic>
#include <mbedtls/base64.h>
#include <mbedtls/gcm.h>
#include "aes_link.h"

// WLED's R/G/B/W color macros collide with template parameters in MsgPack's
// type traits. Hide them only while that header is parsed.
#pragma push_macro("R")
#pragma push_macro("G")
#pragma push_macro("B")
#pragma push_macro("W")
#undef R
#undef G
#undef B
#undef W
#define DEBUGLOG_DEFAULT_LOG_LEVEL_ERROR
#include <MsgPack.h>
#pragma pop_macro("W")
#pragma pop_macro("B")
#pragma pop_macro("G")
#pragma pop_macro("R")

#ifdef WHITE
#undef WHITE
#endif
#ifdef BLACK
#undef BLACK
#endif
#include <Wire.h>
#include <Adafruit_GFX.h>
#include <Adafruit_SSD1306.h>

// AI: below section was generated by an AI
// Production receiver. WLED keeps its own Wi-Fi stack; this usermod only listens
// on the SX1276. One MessagePack object per LoRa frame is applied with the same
// path as POST /json/state. A frame may be the state object itself, or
// {"state":{...}} when it has no top-level on/bri/seg keys.
// LED data stays on GPIO 4 via DATA_PINS in the ttgo_t32 environment.
//
// The MessagePack is wrapped in an AES-128-GCM frame. The same key, stored from
// Config > Usermods, is required for HTTP/WebSocket state changes.
//
// Radio defaults match RadioLib SX1276::begin() aside from the frequency:
// 915.0 MHz, bandwidth 125 kHz, spreading factor 9, coding rate 4/7,
// sync word 0x12, CRC enabled. The sender must use the same PHY settings.
// Example object: {"on":true,"bri":128,"seg":[{"id":0,"fx":0,"col":[[255,0,0]]}]}

#ifndef LORA_SCK
#define LORA_SCK 5
#endif
#ifndef LORA_MISO
#define LORA_MISO 19
#endif
#ifndef LORA_MOSI
#define LORA_MOSI 27
#endif
#ifndef LORA_CS
#define LORA_CS 18
#endif
#ifndef LORA_DIO0
#define LORA_DIO0 26
#endif
#ifndef LORA_DIO1
#define LORA_DIO1 33
#endif
#ifndef LORA_DIO2
#define LORA_DIO2 32
#endif
#ifndef LORA_RST
#define LORA_RST 23
#endif
#ifndef LORA_FREQ
#define LORA_FREQ 915.0
#endif

namespace {
constexpr uint32_t kTaskStackBytes = 10240;
constexpr UBaseType_t kTaskPriority = 1;
constexpr BaseType_t kTaskCore = 0;
constexpr TickType_t kRxWaitTicks = pdMS_TO_TICKS(100);
constexpr size_t kMaxPacket = 255;
constexpr uint8_t kAesMagic = 0xA1;
constexpr size_t kAesNonce = 12;
constexpr size_t kAesTag = 16;
constexpr size_t kAesOverhead = 1 + kAesNonce + kAesTag;
constexpr size_t kNonceSlots = 16;
constexpr char kKeyFile[] = "/aes128.key";
constexpr uint8_t kOledAddress = 0x3C;
constexpr int8_t kOledSda = 21;
constexpr int8_t kOledScl = 22;

Adafruit_SSD1306 oled(128, 64, &Wire, -1);
bool oledReady = false;
char oledCache[96] = {0};

SX1276* radio = nullptr;
SemaphoreHandle_t rxReady = nullptr;
TaskHandle_t rxTask = nullptr;
std::atomic<bool> radioReady{false};
std::atomic<uint32_t> packetsApplied{0};
std::atomic<uint32_t> packetsSent{0};
std::atomic<bool> txBusy{false};
std::atomic<uint32_t> txDoneAt{0};
std::atomic<int16_t> lastRssi{0};
std::atomic<uint8_t> roleRaw{0};   // 0 receiver, 1 transmitter
std::atomic<uint8_t> inputRaw{1};  // 0 wifi, 1 lora

SemaphoreHandle_t txReady = nullptr;
uint8_t pendingFrame[kMaxPacket];
size_t pendingLen = 0;
bool rxListening = false;

bool isTransmitter() { return roleRaw.load() == 1; }
bool IRAM_ATTR listenLoRa() { return roleRaw.load() == 0 && inputRaw.load() == 1; }

bool sendingNow() {
  if (!isTransmitter()) return false;
  if (txBusy.load()) return true;
  const uint32_t done = txDoneAt.load();
  return done != 0 && (uint32_t)(millis() - done) < 2000;
}

SemaphoreHandle_t aesLock = nullptr;
uint8_t aesKey[16] = {0};
bool aesReady = false;
uint8_t aesNonces[kNonceSlots][kAesNonce] = {};
uint8_t aesNonceCount = 0;
uint8_t aesNonceNext = 0;

void ensureAesLock() {
  if (aesLock) return;
  aesLock = xSemaphoreCreateMutex();
}

void lockAes() {
  ensureAesLock();
  if (aesLock) xSemaphoreTake(aesLock, portMAX_DELAY);
}

void unlockAes() {
  if (aesLock) xSemaphoreGive(aesLock);
}

int hexNibble(char c) {
  if (c >= '0' && c <= '9') return c - '0';
  if (c >= 'a' && c <= 'f') return c - 'a' + 10;
  if (c >= 'A' && c <= 'F') return c - 'A' + 10;
  return -1;
}

bool parseHexKey(const char* text, uint8_t out[16]) {
  if (!text) return false;
  for (uint8_t i = 0; i < 16; i++) {
    const int hi = hexNibble(text[i * 2]);
    const int lo = hexNibble(text[i * 2 + 1]);
    if (hi < 0 || lo < 0) return false;
    out[i] = (uint8_t)((hi << 4) | lo);
  }
  return text[32] == '\0' || text[32] == '\n' || text[32] == '\r';
}

bool keysEqual(const uint8_t* a, const uint8_t* b) {
  uint8_t diff = 0;
  for (uint8_t i = 0; i < 16; i++) diff |= (uint8_t)(a[i] ^ b[i]);
  return diff == 0;
}

bool nonceSeen(const uint8_t* nonce) {
  const uint8_t limit = aesNonceCount < kNonceSlots ? aesNonceCount : kNonceSlots;
  for (uint8_t i = 0; i < limit; i++) {
    if (memcmp(aesNonces[i], nonce, kAesNonce) == 0) return true;
  }
  return false;
}

void rememberNonce(const uint8_t* nonce) {
  memcpy(aesNonces[aesNonceNext], nonce, kAesNonce);
  aesNonceNext = (uint8_t)((aesNonceNext + 1) % kNonceSlots);
  if (aesNonceCount < kNonceSlots) aesNonceCount++;
}

void loadKeyFromFile() {
  lockAes();
  File file = WLED_FS.open(kKeyFile, "r");
  if (!file) {
    aesReady = false;
    unlockAes();
    return;
  }
  char hex[40] = {0};
  const size_t n = file.readBytes(hex, sizeof(hex) - 1);
  file.close();
  hex[n] = '\0';
  uint8_t parsed[16];
  if (n >= 32 && parseHexKey(hex, parsed)) {
    memcpy(aesKey, parsed, 16);
    aesReady = true;
  } else {
    aesReady = false;
  }
  unlockAes();
}

bool storeKeyHex(const char* hex) {
  uint8_t parsed[16];
  if (!parseHexKey(hex, parsed)) return false;
  File file = WLED_FS.open(kKeyFile, "w");
  if (!file) return false;
  const size_t wrote = file.write((const uint8_t*)hex, 32);
  file.close();
  if (wrote != 32) return false;
  lockAes();
  memcpy(aesKey, parsed, 16);
  aesReady = true;
  aesNonceCount = 0;
  aesNonceNext = 0;
  unlockAes();
  return true;
}

// plaintext out. Caller holds no lock; this function takes aesLock.
bool decryptFrame(const uint8_t* frame, size_t frameLen, uint8_t* plain, size_t plainCap, size_t* plainLen) {
  if (!frame || !plain || !plainLen) return false;
  if (frameLen < kAesOverhead || frame[0] != kAesMagic) return false;
  const size_t ctLen = frameLen - kAesOverhead;
  if (ctLen > plainCap) return false;

  lockAes();
  if (!aesReady) {
    unlockAes();
    return false;
  }
  const uint8_t* nonce = frame + 1;
  const uint8_t* cipher = frame + 1 + kAesNonce;
  const uint8_t* tag = frame + frameLen - kAesTag;
  if (nonceSeen(nonce)) {
    unlockAes();
    return false;
  }

  uint8_t keyCopy[16];
  memcpy(keyCopy, aesKey, 16);
  mbedtls_gcm_context gcm;
  mbedtls_gcm_init(&gcm);
  int rc = mbedtls_gcm_setkey(&gcm, MBEDTLS_CIPHER_ID_AES, keyCopy, 128);
  if (rc == 0) {
    rc = mbedtls_gcm_auth_decrypt(&gcm, ctLen, nonce, kAesNonce, nullptr, 0, tag, kAesTag, cipher, plain);
  }
  mbedtls_gcm_free(&gcm);
  if (rc != 0) {
    unlockAes();
    return false;
  }
  rememberNonce(nonce);
  *plainLen = ctLen;
  unlockAes();
  return true;
}

bool decryptBase64(const char* b64, uint8_t* plain, size_t plainCap, size_t* plainLen) {
  if (!b64 || !b64[0]) return false;
  static SemaphoreHandle_t decodeLock = nullptr;
  static uint8_t frame[4096];
  if (!decodeLock) decodeLock = xSemaphoreCreateMutex();
  if (decodeLock) xSemaphoreTake(decodeLock, portMAX_DELAY);
  size_t frameLen = 0;
  const int rc = mbedtls_base64_decode(frame, sizeof(frame), &frameLen, (const unsigned char*)b64, strlen(b64));
  const bool ok = rc == 0 && frameLen > 0 && decryptFrame(frame, frameLen, plain, plainCap, plainLen);
  if (decodeLock) xSemaphoreGive(decodeLock);
  return ok;
}

void IRAM_ATTR onDio0() {
  if (!listenLoRa()) return;
  BaseType_t wake = pdFALSE;
  if (rxReady) xSemaphoreGiveFromISR(rxReady, &wake);
  portYIELD_FROM_ISR(wake);
}

bool spiBusReady() {
  const int8_t pins[3] = {LORA_SCK, LORA_MISO, LORA_MOSI};
  bool anyTaken = false;
  bool anyFree = false;
  for (uint8_t i = 0; i < 3; i++) {
    if (PinManager::isPinAllocated(pins[i])) {
      if (PinManager::getPinOwner(pins[i]) != PinOwner::HW_SPI) return false;
      anyTaken = true;
    } else {
      anyFree = true;
    }
  }
  if (anyTaken && anyFree) return false;
  if (anyTaken) return true;

  const PinManagerPinType spiPins[3] = {
    {LORA_SCK, true},
    {LORA_MISO, true},
    {LORA_MOSI, true}
  };
  return PinManager::allocateMultiplePins(spiPins, 3, PinOwner::HW_SPI);
}

bool claimRadioPin(int8_t pin, bool output) {
  if (!PinManager::allocatePin(pin, output, PinOwner::UM_LoRa)) {
    DEBUG_PRINTF_P(PSTR("LoRa: GPIO %d is not available\n"), pin);
    return false;
  }
  return true;
}

bool unpackAndApply(const uint8_t* frame, size_t frameLen) {
  uint8_t data[kMaxPacket];
  size_t len = 0;
  if (!decryptFrame(frame, frameLen, data, sizeof(data), &len) || len == 0) return false;
  if (!requestJSONBufferLock(JSON_LOCK_LORA)) return false;

  bool applied = false;
  MsgPack::Unpacker unpacker;
  if (unpacker.feed(data, len)) {
#if defined(BOARD_HAS_PSRAM)
    const bool unpacked = !deserializeMsgPack(*pDoc, data, len);
#else
    const bool unpacked = unpacker.deserialize(gDoc);
#endif
    if (unpacked) {
      JsonObject root = pDoc->as<JsonObject>();
      JsonObject nested = root[F("state")].as<JsonObject>();
      const bool bareState = !root[F("on")].isNull() || !root[F("bri")].isNull() || !root[F("seg")].isNull() || !root[F("ps")].isNull();
      if (!nested.isNull() && !bareState) root = nested;
      if (!root.isNull()) {
        deserializeState(root, CALL_MODE_DIRECT_CHANGE);
        applied = true;
      }
    }
  }

  releaseJSONBufferLock();
  return applied;
}

bool queueAirFrame(const char* b64) {
  if (!b64 || !b64[0] || !radio) return false;
  uint8_t frame[kMaxPacket];
  size_t frameLen = 0;
  const int rc = mbedtls_base64_decode(frame, sizeof(frame), &frameLen, (const unsigned char*)b64, strlen(b64));
  if (rc != 0 || frameLen < kAesOverhead || frameLen > kMaxPacket || frame[0] != kAesMagic) return false;
  lockAes();
  memcpy(pendingFrame, frame, frameLen);
  pendingLen = frameLen;
  unlockAes();
  if (txReady) xSemaphoreGive(txReady);
  return true;
}

void transmitPending() {
  if (!radio) return;
  uint8_t frame[kMaxPacket];
  size_t len = 0;
  lockAes();
  len = pendingLen;
  if (len > 0 && len <= kMaxPacket) memcpy(frame, pendingFrame, len);
  pendingLen = 0;
  unlockAes();
  if (len < kAesOverhead) return;

  radio->clearPacketReceivedAction();
  txBusy.store(true);
  const int16_t state = radio->transmit(frame, len);
  txBusy.store(false);
  radio->setPacketReceivedAction(onDio0);
  rxListening = false;
  if (state == RADIOLIB_ERR_NONE) {
    packetsSent.fetch_add(1);
    txDoneAt.store(millis());
  } else {
    DEBUG_PRINTF_P(PSTR("LoRa: transmit %d\n"), state);
  }
}

void handleFrame() {
  if (!radio || !listenLoRa()) return;

  const size_t len = radio->getPacketLength();
  if (len == 0 || len > kMaxPacket) {
    radio->startReceive();
    return;
  }

  uint8_t packet[kMaxPacket];
  const int16_t state = radio->readData(packet, len);
  if (state == RADIOLIB_ERR_NONE) {
    lastRssi.store((int16_t)radio->getRSSI());
    if (unpackAndApply(packet, len)) packetsApplied.fetch_add(1);
    else DEBUG_PRINTF_P(PSTR("LoRa: ignored %u byte frame\n"), (unsigned)len);
  } else {
    DEBUG_PRINTF_P(PSTR("LoRa: readData %d\n"), state);
  }
  radio->startReceive();
}

void formatIp(const IPAddress& ip, char* dest, size_t destLen) {
  snprintf(dest, destLen, "%u.%u.%u.%u", ip[0], ip[1], ip[2], ip[3]);
}

void initOled() {
  Wire.begin(kOledSda, kOledScl);
  oledReady = oled.begin(SSD1306_SWITCHCAPVCC, kOledAddress, false, false);
  if (!oledReady) return;
  oled.clearDisplay();
  oled.setTextColor(SSD1306_WHITE);
  oled.setTextSize(1);
  oled.setCursor(0, 0);
  oled.print(F("WiFi ..."));
  oled.setCursor(0, 28);
  oled.setTextSize(2);
  oled.print(F("LoRa .."));
  oled.display();
}

void refreshOled(bool force) {
  if (!oledReady) return;
  const bool sta = WLED_CONNECTED;
  const bool ap = apActive;
  char staIp[16] = {0};
  char apIp[16] = {0};
  if (sta) formatIp(WLEDNetwork.localIP(), staIp, sizeof(staIp));
  if (ap) formatIp(WiFi.softAPIP(), apIp, sizeof(apIp));

  const char* wifi = sta ? "WiFi OK" : (ap ? "WiFi AP" : "WiFi OFF");
  const char* ip = sta ? staIp : (ap ? apIp : "sin IP");
  const bool tx = isTransmitter();
  const bool sending = sendingNow();
  const char* role = !radioReady.load() ? "OFF" : (tx ? "TRANSMITE" : "RECIBE");
  const char* via = tx || inputRaw.load() == 1 ? "LoRa" : "WiFi";
  const char* aes = aesReady ? "ON" : "OFF";
  const unsigned packets = tx ? packetsSent.load() : packetsApplied.load();

  char signature[96];
  snprintf(signature, sizeof(signature), "%s|%s|%s|%s|%s|%d|%u", wifi, ip, role, via, aes, sending ? 1 : 0, packets);
  if (!force && strcmp(signature, oledCache) == 0) return;
  strncpy(oledCache, signature, sizeof(oledCache) - 1);

  oled.clearDisplay();
  oled.setTextColor(SSD1306_WHITE);
  oled.setTextSize(1);
  oled.setCursor(0, 0);
  oled.print(wifi);
  oled.setCursor(92, 0);
  oled.print(F("AES"));
  oled.setCursor(0, 10);
  oled.print(ip);
  oled.setCursor(92, 10);
  oled.print(aes);

  oled.setTextSize(2);
  oled.setCursor(0, 22);
  oled.print(role);

  if (sending) {
    oled.fillRect(0, 42, 128, 22, SSD1306_WHITE);
    oled.setTextColor(SSD1306_BLACK);
    oled.setTextSize(1);
    oled.setCursor(4, 45);
    oled.print(F("ENVIANDO"));
    oled.setCursor(4, 55);
    oled.print(F("datos via LoRa"));
  } else {
    oled.setTextSize(1);
    oled.setCursor(0, 46);
    oled.print(F("via "));
    oled.print(via);
    if (packets > 0) {
      char count[16];
      snprintf(count, sizeof(count), "n:%u", packets);
      oled.setCursor(72, 46);
      oled.print(count);
    }
  }
  oled.display();
}

void rxTaskFn(void*) {
  for (;;) {
    if (!radioReady.load()) {
      delay(50);
      continue;
    }
    if (isTransmitter()) {
      rxListening = false;
      if (txReady && xSemaphoreTake(txReady, kRxWaitTicks) == pdTRUE) transmitPending();
    } else if (listenLoRa()) {
      if (!rxListening) {
        if (radio->startReceive() == RADIOLIB_ERR_NONE) rxListening = true;
      }
      if (xSemaphoreTake(rxReady, kRxWaitTicks) == pdTRUE) handleFrame();
    } else {
      rxListening = false;
      vTaskDelay(pdMS_TO_TICKS(200));
    }
    delay(1);
  }
}
}  // namespace

class LoRaRxUsermod : public Usermod {
 public:
  void setup() override {
    ensureAesLock();
    loadKeyFromFile();
    initOled();
    refreshOled(true);
    if (!spiBusReady()) {
      DEBUG_PRINTLN(F("LoRa: SPI pins are not available"));
      return;
    }
    if (!claimRadioPin(LORA_CS, true) || !claimRadioPin(LORA_RST, true) || !claimRadioPin(LORA_DIO0, false)) return;
    // DIO1 and DIO2 stay wired to the SX1276 even when RadioLib does not use them.
    if (!claimRadioPin(LORA_DIO1, false) || !claimRadioPin(LORA_DIO2, false)) return;

    SPI.begin(LORA_SCK, LORA_MISO, LORA_MOSI, LORA_CS);
    radio = new SX1276(new Module(LORA_CS, LORA_DIO0, LORA_RST, RADIOLIB_NC));
    if (!radio) return;

    const int16_t state = radio->begin(LORA_FREQ);
    if (state != RADIOLIB_ERR_NONE) {
      DEBUG_PRINTF_P(PSTR("LoRa: SX1276 begin failed (%d)\n"), state);
      return;
    }

    rxReady = xSemaphoreCreateBinary();
    txReady = xSemaphoreCreateBinary();
    if (!rxReady || !txReady) return;

    radio->setPacketReceivedAction(onDio0);
    if (listenLoRa() && radio->startReceive() == RADIOLIB_ERR_NONE) rxListening = true;

    if (xTaskCreatePinnedToCore(rxTaskFn, "lora_rx", kTaskStackBytes, nullptr, kTaskPriority, &rxTask, kTaskCore) != pdPASS) {
      DEBUG_PRINTLN(F("LoRa: task was not created"));
      return;
    }
    radioReady.store(true);
    refreshOled(true);
    DEBUG_PRINTF_P(PSTR("LoRa: listening at %.1f MHz\n"), (double)LORA_FREQ);
  }

  void loop() override {
    static uint32_t lastPaint = 0;
    const uint32_t now = millis();
    const uint32_t period = isTransmitter() ? 200 : 1000;
    if ((uint32_t)(now - lastPaint) < period) return;
    lastPaint = now;
    refreshOled(false);
  }

  void connected() override {
    refreshOled(true);
  }

  void onUpdateBegin(bool init) override {
    if (!rxTask) return;
    if (init) vTaskSuspend(rxTask);
    else vTaskResume(rxTask);
  }

  void addToJsonInfo(JsonObject& root) override {
    JsonObject user = root["u"];
    if (user.isNull()) user = root.createNestedObject("u");
    JsonArray status = user.createNestedArray(F("LoRa"));
    if (!radioReady.load()) {
      status.add(F("off"));
    } else if (isTransmitter()) {
      status.add(F("tx"));
      status.add(packetsSent.load());
    } else {
      status.add(inputRaw.load() == 0 ? F("wifi") : F("rx"));
      status.add(packetsApplied.load());
      status.add(lastRssi.load());
    }
    JsonArray aes = user.createNestedArray(F("AES-128"));
    aes.add(aesReady ? F("on") : F("set key"));
    root[F("aes128")] = aesReady;
  }

  void appendConfigData(Print& settingsScript) override {
    settingsScript.print(F("addInfo('lora_rx:aes_key',1,'32 hex. Blank keeps the current key.');"));
    settingsScript.print(F("addInfo('lora_rx:aes_unlock',1,'Current key. Required only to replace it.');"));
    settingsScript.print(F("addInfo('lora_rx:lora_role',1,'tx reenvia la trama WiFi por LoRa. rx aplica a la tira.');"));
    settingsScript.print(F("addInfo('lora_rx:rx_input',1,'Canal del receptor. Se ignora si el rol es tx.');"));
    settingsScript.print(F("var ak=d.getElementsByName('lora_rx:aes_key'); if(ak[1]){ak[1].type='password'; ak[1].maxLength=32;}"));
    settingsScript.print(F("var au=d.getElementsByName('lora_rx:aes_unlock'); if(au[1]){au[1].type='password'; au[1].maxLength=32;}"));
    settingsScript.print(F("function loraSel(n,opts){var a=d.getElementsByName(n); if(!a.length)return; var inp=a[a.length-1]; var sel=document.createElement('select'); sel.name=n; var cur=inp.value; for(var i=0;i<opts.length;i++){var op=document.createElement('option'); op.value=opts[i][0]; op.text=opts[i][1]; if(opts[i][0]===cur) op.selected=true; sel.appendChild(op);} inp.parentElement.replaceChild(sel, inp);}"));
    settingsScript.print(F("loraSel('lora_rx:lora_role',[['rx','Receptor'],['tx','Transmisor']]);"));
    settingsScript.print(F("loraSel('lora_rx:rx_input',[['lora','LoRa'],['wifi','WiFi']]);"));
  }

  void addToConfig(JsonObject& obj) override {
    JsonObject top = obj.createNestedObject(F("lora_rx"));
    // Never write the secret back into cfg.json. The key lives in /aes128.key.
    top[F("aes_key")] = "";
    top[F("aes_unlock")] = "";
    top[F("lora_role")] = isTransmitter() ? "tx" : "rx";
    top[F("rx_input")] = inputRaw.load() == 0 ? "wifi" : "lora";
  }

  bool readFromConfig(JsonObject& obj) override {
    JsonObject top = obj[F("lora_rx")];
    if (top.isNull()) return false;
    const char* role = top[F("lora_role")] | "rx";
    const char* input = top[F("rx_input")] | "lora";
    roleRaw.store(strcmp(role, "tx") == 0 ? 1 : 0);
    inputRaw.store(strcmp(input, "wifi") == 0 ? 0 : 1);
    const char* nextKey = top[F("aes_key")] | "";
    const char* unlock = top[F("aes_unlock")] | "";
    if (!nextKey[0]) return true;

    uint8_t parsed[16];
    if (!parseHexKey(nextKey, parsed)) return true;
    lockAes();
    const bool have = aesReady;
    uint8_t current[16];
    if (have) memcpy(current, aesKey, 16);
    unlockAes();
    if (have) {
      uint8_t presented[16];
      if (!parseHexKey(unlock, presented) || !keysEqual(presented, current)) return true;
    }
    storeKeyHex(nextKey);
    return true;
  }

  uint16_t getId() override { return USERMOD_ID_LORA; }
};

static LoRaRxUsermod loraRxUsermod;
REGISTER_USERMOD(loraRxUsermod);

bool wledAesKeyActive() {
  return aesReady;
}

bool wledAesAccept(JsonDocument& doc, bool applyState) {
  JsonObject root = doc.as<JsonObject>();
  if (root.isNull()) return false;

  if (isTransmitter() && applyState) {
    const char* b64 = root[F("aes")].as<const char*>();
    if (!queueAirFrame(b64)) return false;
    doc.clear();
    doc[F("v")] = true;
    return true;
  }

  if (!isTransmitter() && inputRaw.load() == 1 && applyState) {
    if (root.size() == 1 && (!root[F("v")].isNull() || !root[F("lv")].isNull())) return true;
    doc.clear();
    doc[F("v")] = true;
    return true;
  }

  if (!aesReady) return true;
  if (root.size() == 1 && (!root[F("v")].isNull() || !root[F("lv")].isNull())) return true;

  const char* b64 = root[F("aes")].as<const char*>();
  if (!b64) return false;
  static uint8_t plain[4096];
  size_t plainLen = 0;
  if (!decryptBase64(b64, plain, sizeof(plain), &plainLen) || plainLen == 0) return false;
  return !deserializeJson(doc, plain, plainLen);
}

bool wledAesAllowHttp(const String& url, const char* headerB64) {
  if (!aesReady) return true;
  if (!headerB64 || !headerB64[0]) return false;
  uint8_t plain[292];
  size_t plainLen = 0;
  if (!decryptBase64(headerB64, plain, sizeof(plain) - 1, &plainLen)) return false;
  plain[plainLen] = 0;
  if (plainLen != url.length()) return false;
  return memcmp(plain, url.c_str(), plainLen) == 0;
}
// AI: end

#endif  // ARDUINO_ARCH_ESP32
